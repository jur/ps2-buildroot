## package/juhutube-installer/Config.in
```kconfig
config BR2_PACKAGE_JUHUTUBE_INSTALLER
	bool "juhutube-installer"
	depends on BR2_PACKAGE_WGET || BR2_PACKAGE_BUSYBOX
	depends on BR2_TOOLCHAIN_BUILDROOT_INET_IPV6
	depends on BR2_INET_IPV6
	depends on BR2_PACKAGE_DOSFSTOOLS
	depends on BR2_PACKAGE_DOSFSTOOLS_MKFS_FAT
	depends on BR2_PACKAGE_E2FSPROGS
	depends on BR2_PACKAGE_E2FSPROGS_MKE2FS
	depends on BR2_PACKAGE_E2FSPROGS_RESIZE2FS
	depends on BR2_PACKAGE_PARTED
	depends on BR2_INIT_BUSYBOX
	help
	  Installer for youtube player for embedded systems.

	  https://github.com/jur/juhutube
```

## package/juhutube/Config.in
```kconfig
config BR2_PACKAGE_JUHUTUBE
	bool "juhutube"
	depends on BR2_PACKAGE_YOUTUBE_DL
	depends on BR2_PACKAGE_JSON_C
	depends on BR2_PACKAGE_SDL
	depends on BR2_PACKAGE_SDL_IMAGE
	depends on BR2_PACKAGE_SDL_TTF
	depends on BR2_PACKAGE_MPLAYER_MPLAYER || BR2_PACKAGE_FFMPEG_FFPLAY
	depends on BR2_PACKAGE_WGET || BR2_PACKAGE_CURL
	depends on BR2_PACKAGE_LIBCURL
	help
	  Youtube player for embedded systems.

	  https://github.com/jur/juhutube
```

## package/youtube-dl/Config.in
```kconfig
config BR2_PACKAGE_YOUTUBE_DL
	bool "youtube-dl"
	depends on BR2_PACKAGE_PYTHON
	depends on BR2_PACKAGE_PYTHON_PYEXPAT
	depends on BR2_PACKAGE_PYTHON_ZLIB
	help
	  Youtube downloader.

	  http://rg3.github.io/youtube-dl/
```
